## embarcados/Embarcados/zephyrproject/Projeto/build/Kconfig/boards/Kconfig.nucleo_g474re
```kconfig
# Load board Kconfig descriptions.
osource "C:/Users/brun0/Documents/Embarcados/zephyrproject/zephyr/boards/st/nucleo_g474re/Kconfig.nucleo_g474re"
```

## embarcados/Embarcados/zephyrproject/Projeto2/build/Kconfig/boards/Kconfig.defconfig
```kconfig
# Load Zephyr board defconfig descriptions.
osource "C:/Users/brun0/Documents/Embarcados/zephyrproject/zephyr/boards/st/nucleo_g474re/Kconfig.defconfig"
```
